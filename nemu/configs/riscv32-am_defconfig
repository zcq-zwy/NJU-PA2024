## nemu/configs/riscv32-am_defconfig
```kconfig
# CONFIG_TARGET_AM is not set
CONFIG_TARGET_NATIVE_ELF=y
# CONFIG_TRACE is not set
CONFIG_MSIZE=0x10000000
CONFIG_DEVICE=y
CONFIG_HAS_DISK=y
CONFIG_VGA_SIZE_800x600=y
```

## nemu/configs/riscv32-xv6_defconfig
```kconfig
CONFIG_ISA_riscv=y
# CONFIG_RV64 is not set
# CONFIG_RVE is not set
CONFIG_ENGINE_INTERPRETER=y
CONFIG_MODE_SYSTEM=y
CONFIG_TARGET_NATIVE_ELF=y
CONFIG_CC_GCC=y
CONFIG_CC_O2=y
# CONFIG_TRACE is not set
CONFIG_WATCHPOINT=y
CONFIG_MBASE=0x80000000
CONFIG_MSIZE=0x10000000
CONFIG_PC_RESET_OFFSET=0
CONFIG_PMEM_MALLOC=y
# CONFIG_MEM_RANDOM is not set
CONFIG_DEVICE=y
# CONFIG_HAS_SERIAL is not set
CONFIG_HAS_XV6_UART=y
CONFIG_XV6_UART_MMIO=0x10000000
CONFIG_XV6_UART_IRQ=10
CONFIG_HAS_XV6_CLINT=y
CONFIG_XV6_CLINT_MMIO=0x02000000
CONFIG_HAS_XV6_PLIC=y
CONFIG_XV6_PLIC_MMIO=0x0c000000
CONFIG_HAS_XV6_VIRTIO_BLK=y
CONFIG_XV6_VIRTIO_BLK_MMIO=0x10001000
CONFIG_XV6_VIRTIO_BLK_IRQ=1
CONFIG_HAS_XV6_E1000=y
CONFIG_XV6_E1000_MMIO=0x10002000
CONFIG_XV6_E1000_IRQ=11
# CONFIG_HAS_TIMER is not set
# CONFIG_HAS_KEYBOARD is not set
# CONFIG_HAS_VGA is not set
# CONFIG_HAS_AUDIO is not set
# CONFIG_HAS_DISK is not set
CONFIG_RT_CHECK=y
# CONFIG_LOOP_DETECT is not set
```

## nemu/src/device/Kconfig
```kconfig
menuconfig DEVICE
  depends on !TARGET_SHARE
  bool "Devices"
  default n
  help
    Provide device support for NEMU.

if DEVICE

config HAS_PORT_IO
  bool
  default y if ISA_x86
  default n

menuconfig HAS_SERIAL
  bool "Enable serial"
  default y

if HAS_SERIAL
config SERIAL_PORT
  depends on HAS_PORT_IO
  hex "Port address of the serial controller"
  default 0x3f8

config SERIAL_MMIO
  hex "MMIO address of the serial controller"
  default 0xa00003f8

config SERIAL_INPUT_FIFO
  bool "Enable input FIFO with /tmp/nemu.serial"
  default n
endif # HAS_SERIAL

menuconfig HAS_XV6_UART
  depends on !TARGET_AM
  bool "Enable xv6 UART"
  default n

if HAS_XV6_UART
config XV6_UART_MMIO
  hex "MMIO address of the xv6 UART controller"
  default 0x10000000

config XV6_UART_IRQ
  int "IRQ number of the xv6 UART controller"
  default 10
endif # HAS_XV6_UART

menuconfig HAS_XV6_CLINT
  depends on !TARGET_AM
  bool "Enable xv6 CLINT"
  default n

if HAS_XV6_CLINT
config XV6_CLINT_MMIO
  hex "MMIO address of the xv6 CLINT"
  default 0x02000000
endif # HAS_XV6_CLINT

menuconfig HAS_XV6_PLIC
  depends on !TARGET_AM
  bool "Enable xv6 PLIC"
  default n

if HAS_XV6_PLIC
config XV6_PLIC_MMIO
  hex "MMIO address of the xv6 PLIC"
  default 0x0c000000
endif # HAS_XV6_PLIC

menuconfig HAS_XV6_VIRTIO_BLK
  depends on !TARGET_AM
  bool "Enable xv6 virtio-mmio block"
  default n

if HAS_XV6_VIRTIO_BLK
config XV6_VIRTIO_BLK_MMIO
  hex "MMIO address of the xv6 virtio block device"
  default 0x10001000

config XV6_VIRTIO_BLK_IRQ
  int "IRQ number of the xv6 virtio block device"
  default 1
endif # HAS_XV6_VIRTIO_BLK

menuconfig HAS_TIMER
  bool "Enable timer"
  default y

if HAS_TIMER
config RTC_PORT
  depends on HAS_PORT_IO
  hex "Port address of the timer"
  default 0x48

config RTC_MMIO
  hex "MMIO address of the timer"
  default 0xa0000048
endif # HAS_TIMER

menuconfig HAS_KEYBOARD
  bool "Enable keyboard"
  default y

if HAS_KEYBOARD
config I8042_DATA_PORT
  depends on HAS_PORT_IO
  hex "Port address of the keyboard controller"
  default 0x60

config I8042_DATA_MMIO
  hex "MMIO address of the keyboard controller"
  default 0xa0000060
endif # HAS_KEYBOARD

menuconfig HAS_VGA
  bool "Enable VGA"
  default y

if HAS_VGA
config FB_ADDR
  hex "Physical address of the VGA frame buffer"
  default 0xa1000000

config VGA_CTL_PORT
  depends on HAS_PORT_IO
  hex "Port address of the VGA controller"
  default 0x100

config VGA_CTL_MMIO
  hex "MMIO address of the VGA controller"
  default 0xa0000100

config VGA_SHOW_SCREEN
  bool "Enable SDL SCREEN"
  default y

if VGA_SHOW_SCREEN && !TARGET_AM
choice
  prompt "SDL renderer policy"
  default VGA_RENDERER_AUTO
config VGA_RENDERER_AUTO
  bool "Auto"
config VGA_RENDERER_SOFTWARE
  bool "Software"
config VGA_RENDERER_ACCELERATED
  bool "Accelerated"
endchoice
endif

choice
  prompt "Screen Size"
  default VGA_SIZE_400x300
config VGA_SIZE_400x300
  bool "400 x 300"
config VGA_SIZE_800x600
  bool "800 x 600"
endchoice
endif # HAS_VGA

if !TARGET_AM
menuconfig HAS_AUDIO
  bool "Enable audio"
  default y

if HAS_AUDIO
config SB_ADDR
  hex "Physical address of the audio stream buffer"
  default 0xa1200000

config SB_SIZE
  hex "Size of the audio stream buffer"
  default 0x10000

config AUDIO_CTL_PORT
  depends on HAS_PORT_IO
  hex "Port address of the audio controller"
  default 0x200

config AUDIO_CTL_MMIO
  hex "MMIO address of the audio controller"
  default 0xa0000200
endif # HAS_AUDIO

menuconfig HAS_DISK
  bool "Enable disk"
  default y

if HAS_DISK
config DISK_CTL_PORT
  depends on HAS_PORT_IO
  hex "Port address of the disk controller"
  default 0x300

config DISK_CTL_MMIO
  hex "MMIO address of the disk controller"
  default 0xa0000300

config DISK_IMG_PATH
  string "The path of disk image"
  default ""
endif # HAS_DISK

menuconfig HAS_SDCARD
  bool "Enable sdcard"
  default n

if HAS_SDCARD
config SDCARD_CTL_MMIO
  hex "MMIO address of the sdcard controller"
  default 0xa3000000

config SDCARD_IMG_PATH
  string "The path of sdcard image"
  default ""
endif # HAS_SDCARD
endif

endif # DEVICE
```
